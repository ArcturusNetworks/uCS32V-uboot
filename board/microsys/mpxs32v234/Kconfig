## board/microsys/mpxs32v234/Kconfig
```kconfig
if TARGET_MPXS32V234

config SYS_BOARD
	string
	default "mpxs32v234"

config SYS_VENDOR
	string
	default "microsys"

config SYS_CONFIG_NAME
	string
	default "mpxs32v234"

# S32V234EVB rev. A board with DDR3 has 4x512 MB DDR chips
# DDR0(512MB) and DDR1(512MB).
# S32V234EVB rev. D board with LPDDR2 has 2x256 MB DDR chips
# DDR0(256MB) and DDR1(256MB).
# U-boot uses only one DDR slot.

config SYS_DDR_SIZE
	int
	default 2147483648 if S32V234_DDR3
	default 268435456 if S32V234_LPDDR2

config PHY_RGMII_DIRECT_CONNECTED
	bool "Enable fixed PHY for MDIO Bus/PHY emulation with fixed speed/link PHYs"
	default n
	help
	  Adds the platform "fixed" MDIO Bus to cover the boards that
	  use PHYs that are not connected to the real MDIO bus.

endif
```
